# file: internal_flash_test.ioc
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Mcu.Family=STM32F4
Mcu.Name=STM32F429Z(E-G)Tx
Mcu.Package=LQFP144
NVIC.PriorityGroup=NVIC_PRIORITYGROUP_4
PA13.Mode=Serial_Wire
PA13.Signal=SYS_JTMS-SWDIO
PA14.Mode=Serial_Wire
PA14.Signal=SYS_JTCK-SWCLK
PH0/OSC_IN.Mode=HSE-External-Oscillator
PH0/OSC_IN.Signal=RCC_OSC_IN
PH1/OSC_OUT.Mode=HSE-External-Oscillator
PH1/OSC_OUT.Signal=RCC_OSC_OUT
ProjectManager.HeapSize=0x200
ProjectManager.StackSize=0x400
ProjectManager.TargetToolchain=MDK-ARM V5.27
RCC.48MHZClocksFreq_Value=90000000
RCC.AHBFreq_Value=180000000
RCC.APB1CLKDivider=RCC_HCLK_DIV4
RCC.APB1Freq_Value=45000000
RCC.APB1TimFreq_Value=90000000
RCC.APB2CLKDivider=RCC_HCLK_DIV2
RCC.APB2Freq_Value=90000000
RCC.APB2TimFreq_Value=180000000
RCC.CortexFreq_Value=180000000
RCC.HCLKFreq_Value=180000000
RCC.HSE_VALUE=8000000
RCC.HSI_VALUE=16000000
RCC.LSE_VALUE=32768
RCC.PLLM=4
RCC.PLLN=180
RCC.PLLSourceVirtual=RCC_PLLSOURCE_HSE
RCC.SYSCLKFreq_VALUE=180000000
RCC.SYSCLKSource=RCC_SYSCLKSOURCE_PLLCLK
RCC.VCOOutputFreq_Value=360000000
board=custom

// file: Src/main.c
/* USER CODE BEGIN Header */
/**
  ******************************************************************************
  * @file           : main.c
  * @brief          : Main program body
  ******************************************************************************
  * @attention
  *
  * <h2><center>&copy; Copyright (c) 2021 STMicroelectronics.
  * All rights reserved.</center></h2>
  *
  * This software component is licensed by ST under BSD 3-Clause license,
  * the "License"; You may not use this file except in compliance with the
  * License. You may obtain a copy of the License at:
  *                        opensource.org/licenses/BSD-3-Clause
  *
  ******************************************************************************
  */
/* USER CODE END Header */

#include "main.h"
#include "gpio.h"

/* USER CODE BEGIN Includes */
#include "MY_FLASH.h"
/* USER CODE END Includes */

/* USER CODE BEGIN PV */

uint8_t hex_code[3624] ={ 0x40,0x04,0x00,0x20,0xC1,0x01,0x00,0x08,0xBF,0x0C,0x00,0x08,0xED,0x0B,0x00,0x08,
													0xBD,0x0C,0x00,0x08,0xCD,0x02,0x00,0x08,0x6D,0x0D,0x00,0x08,0x00,0x00,0x00,0x00,
													0x00,0x00,0x00,0x00,0x00,0x00,0x00,0x00,0x00,0x00,0x00,0x00,0xC3,0x0C,0x00,0x08,
													0xCF,0x02,0x00,0x08,0x00,0x00,0x00,0x00,0xC1,0x0C,0x00,0x08,0xC5,0x0C,0x00,0x08,
													0xDB,0x01,0x00,0x08,0xDB,0x01,0x00,0x08,0xDB,0x01,0x00,0x08,0xDB,0x01,0x00,0x08,
													0xDB,0x01,0x00,0x08,0xDB,0x01,0x00,0x08,0xDB,0x01,0x00,0x08,0xDB,0x01,0x00,0x08,
													0xDB,0x01,0x00,0x08,0xDB,0x01,0x00,0x08,0xDB,0x01,0x00,0x08,0xDB,0x01,0x00,0x08,
													0xDB,0x01,0x00,0x08,0xDB,0x01,0x00,0x08,0xDB,0x01,0x00,0x08,0xDB,0x01,0x00,0x08,
													0xDB,0x01,0x00,0x08,0xDB,0x01,0x00,0x08,0xDB,0x01,0x00,0x08,0xDB,0x01,0x00,0x08,
													0xDB,0x01,0x00,0x08,0xDB,0x01,0x00,0x08,0xDB,0x01,0x00,0x08,0xDB,0x01,0x00,0x08,
													0xDB,0x01,0x00,0x08,0xDB,0x01,0x00,0x08,0xDB,0x01,0x00,0x08,0xDB,0x01,0x00,0x08,
													0xDB,0x01,0x00,0x08,0xDB,0x01,0x00,0x08,0xDB,0x01,0x00,0x08,0xDB,0x01,0x00,0x08,
													0xDB,0x01,0x00,0x08,0xDB,0x01,0x00,0x08,0xDB,0x01,0x00,0x08,0xDB,0x01,0x00,0x08,
													0xDB,0x01,0x00,0x08,0xDB,0x01,0x00,0x08,0xDB,0x01,0x00,0x08,0xDB,0x01,0x00,0x08,
													0xDB,0x01,0x00,0x08,0xDB,0x01,0x00,0x08,0xDB,0x01,0x00,0x08,0xDB,0x01,0x00,0x08,
													0xDB,0x01,0x00,0x08,0xDB,0x01,0x00,0x08,0xDB,0x01,0x00,0x08,0xDB,0x01,0x00,0x08,
													0xDB,0x01,0x00,0x08,0xDB,0x01,0x00,0x08,0xDB,0x01,0x00,0x08,0xDB,0x01,0x00,0x08,
													0xDB,0x01,0x00,0x08,0xDB,0x01,0x00,0x08,0xDB,0x01,0x00,0x08,0xDB,0x01,0x00,0x08,
													0xDB,0x01,0x00,0x08,0xDB,0x01,0x00,0x08,0xDB,0x01,0x00,0x08,0xDB,0x01,0x00,0x08,
													0xDB,0x01,0x00,0x08,0xDB,0x01,0x00,0x08,0xDB,0x01,0x00,0x08,0xDB,0x01,0x00,0x08,
													0xDB,0x01,0x00,0x08,0xDB,0x01,0x00,0x08,0xDB,0x01,0x00,0x08,0xDB,0x01,0x00,0x08,
													0xDB,0x01,0x00,0x08,0xDB,0x01,0x00,0x08,0xDB,0x01,0x00,0x08,0xDB,0x01,0x00,0x08,
													0xDB,0x01,0x00,0x08,0xDB,0x01,0x00,0x08,0xDB,0x01,0x00,0x08,0xDB,0x01,0x00,0x08,
													0xDB,0x01,0x00,0x08,0xDB,0x01,0x00,0x08,0xDB,0x01,0x00,0x08,0x00,0x00,0x00,0x00,
													0xDB,0x01,0x00,0x08,0xDB,0x01,0x00,0x08,0xDB,0x01,0x00,0x08,0xDB,0x01,0x00,0x08,
													0xDB,0x01,0x00,0x08,0xDB,0x01,0x00,0x08,0xDB,0x01,0x00,0x08,0xDB,0x01,0x00,0x08,
													0xDB,0x01,0x00,0x08,0xDB,0x01,0x00,0x08,0xDB,0x01,0x00,0x08,0xDF,0xF8,0x0C,0xD0,
													0x00,0xF0,0x7A,0xF8,0x00,0x48,0x00,0x47,0xAD,0x0D,0x00,0x08,0x40,0x04,0x00,0x20,
													0x06,0x48,0x80,0x47,0x06,0x48,0x00,0x47,0xFE,0xE7,0xFE,0xE7,0xFE,0xE7,0xFE,0xE7,
													0xFE,0xE7,0xFE,0xE7,0xFE,0xE7,0xFE,0xE7,0xFE,0xE7,0xFE,0xE7,0x51,0x0D,0x00,0x08,
													0xAD,0x01,0x00,0x08,0x2D,0xE9,0xF0,0x5F,0x05,0x46,0x00,0x20,0x92,0x46,0x9B,0x46,
													0x88,0x46,0x06,0x46,0x81,0x46,0x40,0x24,0x1B,0xE0,0x28,0x46,0x41,0x46,0x47,0x46,
													0x22,0x46,0x00,0xF0,0x41,0xF8,0x53,0x46,0x5A,0x46,0xC0,0x1A,0x91,0x41,0x10,0xD3,
													0x11,0x46,0x18,0x46,0x22,0x46,0x00,0xF0,0x28,0xF8,0x2D,0x1A,0x67,0xEB,0x01,0x08,
													0x4F,0x46,0x22,0x46,0x01,0x20,0x00,0x21,0x00,0xF0,0x1F,0xF8,0x17,0xEB,0x00,0x09,
													0x4E,0x41,0x20,0x1E,0xA4,0xF1,0x01,0x04,0xDF,0xDC,0x48,0x46,0x31,0x46,0x2A,0x46,
													0x43,0x46,0xBD,0xE8,0xF0,0x9F,0xD2,0xB2,0x01,0xE0,0x00,0xF8,0x01,0x2B,0x49,0x1E,
													0xFB,0xD2,0x70,0x47,0x00,0x22,0xF6,0xE7,0x10,0xB5,0x13,0x46,0x0A,0x46,0x04,0x46,
													0x19,0x46,0xFF,0xF7,0xF0,0xFF,0x20,0x46,0x10,0xBD,0x20,0x2A,0x04,0xDB,0x20,0x3A,
													0x00,0xFA,0x02,0xF1,0x00,0x20,0x70,0x47,0x91,0x40,0xC2,0xF1,0x20,0x03,0x20,0xFA,
													0x03,0xF3,0x19,0x43,0x90,0x40,0x70,0x47,0x20,0x2A,0x04,0xDB,0x20,0x3A,0x21,0xFA,
													0x02,0xF0,0x00,0x21,0x70,0x47,0x21,0xFA,0x02,0xF3,0xD0,0x40,0xC2,0xF1,0x20,0x02,
													0x91,0x40,0x08,0x43,0x19,0x46,0x70,0x47,0x06,0x4C,0x07,0x4D,0x06,0xE0,0xE0,0x68,
													0x40,0xF0,0x01,0x03,0x94,0xE8,0x07,0x00,0x98,0x47,0x10,0x34,0xAC,0x42,0xF6,0xD3,
													0xFF,0xF7,0x78,0xFF,0xE8,0x0D,0x00,0x08,0x08,0x0E,0x00,0x08,0xFE,0xE7,0x70,0x47,
													0x00,0x22,0x29,0xB1,0x01,0x29,0x1D,0xD0,0x02,0x29,0x1E,0xD0,0x4F,0xF4,0x40,0x72,
													0x0B,0x28,0x00,0xD9,0x00,0x1D,0x0E,0x49,0x0B,0x68,0x23,0xF4,0x40,0x73,0x0B,0x60,
													0x0B,0x68,0x13,0x43,0x0B,0x60,0x0A,0x68,0x22,0xF0,0xF8,0x02,0x0A,0x60,0x0A,0x68,
													0x02,0x23,0x03,0xEB,0xC0,0x00,0x02,0x43,0x0A,0x60,0x08,0x68,0x40,0xF4,0x80,0x30,
													0x08,0x60,0x70,0x47,0x4F,0xF4,0x80,0x72,0xE2,0xE7,0x4F,0xF4,0x00,0x72,0xDF,0xE7,
													0x10,0x3C,0x02,0x40,0x06,0x4A,0x13,0x68,0x23,0xF4,0x40,0x73,0x13,0x60,0x13,0x68,
													0x13,0x60,0x13,0x68,0x43,0xF0,0x01,0x03,0x13,0x60,0x01,0x70,0x70,0x47,0x00,0x00,
													0x10,0x3C,0x02,0x40,0x09,0x49,0x10,0xB5,0x0C,0x68,0x24,0xF4,0x40,0x74,0x0C,0x60,
													0x0C,0x68,0x44,0xF4,0x40,0x74,0x0C,0x60,0x0C,0x68,0x44,0xF0,0x01,0x04,0x0C,0x60,
													0x02,0x60,0xBF,0xF3,0x6F,0x8F,0x43,0x60,0x10,0xBD,0x00,0x00,0x10,0x3C,0x02,0x40,
													0x07,0x4A,0x13,0x68,0x23,0xF4,0x40,0x73,0x13,0x60,0x13,0x68,0x43,0xF4,0x80,0x73,
													0x13,0x60,0x13,0x68,0x43,0xF0,0x01,0x03,0x13,0x60,0x01,0x80,0x70,0x47,0x00,0x00,
													0x10,0x3C,0x02,0x40,0x07,0x4A,0x13,0x68,0x23,0xF4,0x40,0x73,0x13,0x60,0x13,0x68,
													0x43,0xF4,0x00,0x73,0x13,0x60,0x13,0x68,0x43,0xF0,0x01,0x03,0x13,0x60,0x01,0x60,
													0x70,0x47,0x00,0x00,0x10,0x3C,0x02,0x40,0x1C,0x49,0x08,0x68,0xC2,0x06,0x1C,0x48,
													0x05,0xD5,0xC2,0x69,0x42,0xF0,0x10,0x02,0xC2,0x61,0x10,0x22,0x0A,0x60,0x0A,0x68,
													0x92,0x06,0x05,0xD5,0xC2,0x69,0x42,0xF0,0x08,0x02,0xC2,0x61,0x20,0x22,0x0A,0x60,
													0x0A,0x68,0x52,0x06,0x05,0xD5,0xC2,0x69,0x42,0xF0,0x04,0x02,0xC2,0x61,0x40,0x22,
													0x0A,0x60,0x0A,0x68,0x12,0x06,0x05,0xD5,0xC2,0x69,0x42,0xF0,0x02,0x02,0xC2,0x61,
													0x80,0x22,0x0A,0x60,0x0A,0x68,0xD2,0x05,0x06,0xD5,0xC2,0x69,0x42,0xF0,0x01,0x02,
													0xC2,0x61,0x4F,0xF4,0x80,0x72,0x0A,0x60,0x0A,0x68,0x92,0x07,0x05,0xD5,0xC2,0x69,
													0x42,0xF0,0x20,0x02,0xC2,0x61,0x02,0x20,0x08,0x60,0x70,0x47,0x0C,0x3C,0x02,0x40,
													0x20,0x00,0x00,0x20,0x70,0xB5,0x11,0x49,0x04,0x46,0x00,0x20,0xC8,0x61,0x00,0xF0,
													0x7F,0xF8,0x06,0x46,0x0E,0x4D,0x09,0xE0,0x60,0x1C,0x07,0xD0,0x24,0xB1,0x00,0xF0,
													0x77,0xF8,0x80,0x1B,0xA0,0x42,0x01,0xD9,0x03,0x20,0x70,0xBD,0x28,0x68,0xC0,0x03,
													0xF2,0xD4,0x28,0x68,0xC0,0x07,0x01,0xD0,0x01,0x20,0x28,0x60,0x28,0x68,0x10,0xF4,
													0xF9,0x70,0xF2,0xD0,0xFF,0xF7,0xA0,0xFF,0x01,0x20,0x70,0xBD,0x20,0x00,0x00,0x20,
													0x0C,0x3C,0x02,0x40,0x03,0x48,0x01,0x68,0x41,0xF0,0x00,0x41,0x01,0x60,0x00,0x20,
													0x70,0x47,0x00,0x00,0x10,0x3C,0x02,0x40,0x2D,0xE9,0xF0,0x47,0x1B,0x4E,0x05,0x46,
													0x14,0x46,0x30,0x7E,0x1F,0x46,0x89,0x46,0x01,0x28,0x08,0xD0,0x01,0x20,0x30,0x76,
													0x4C,0xF2,0x50,0x38,0x40,0x46,0xFF,0xF7,0xBD,0xFF,0x18,0xB1,0x14,0xE0,0x02,0x20,
													0xBD,0xE8,0xF0,0x87,0x9D,0xB1,0x01,0x2D,0x16,0xD0,0x02,0x2D,0x19,0xD0,0x22,0x46,
													0x3B,0x46,0x48,0x46,0xFF,0xF7,0x36,0xFF,0x40,0x46,0xFF,0xF7,0xAB,0xFF,0x0C,0x49,
													0x0A,0x68,0x22,0xF0,0x01,0x02,0x0A,0x60,0x00,0x21,0x31,0x76,0xE8,0xE7,0xE1,0xB2,
													0x48,0x46,0xFF,0xF7,0x17,0xFF,0xEF,0xE7,0xA1,0xB2,0x48,0x46,0xFF,0xF7,0x38,0xFF,
													0xEA,0xE7,0x21,0x46,0x48,0x46,0xFF,0xF7,0x45,0xFF,0xE5,0xE7,0x20,0x00,0x00,0x20,
													0x10,0x3C,0x02,0x40,0x07,0x49,0x00,0x20,0x0A,0x68,0x00,0x2A,0x09,0xDA,0x05,0x4A,
													0x05,0x4B,0x0C,0x3A,0x13,0x60,0x05,0x4B,0x13,0x60,0x09,0x68,0x00,0x29,0x00,0xDA,
													0x01,0x20,0x70,0x47,0x10,0x3C,0x02,0x40,0x23,0x01,0x67,0x45,0xAB,0x89,0xEF,0xCD,
													0x01,0x48,0x80,0x68,0x70,0x47,0x00,0x00,0x10,0x00,0x00,0x20,0x02,0x48,0x81,0x68,
													0x02,0x78,0x11,0x44,0x81,0x60,0x70,0x47,0x10,0x00,0x00,0x20,0x0B,0x48,0x10,0xB5,
													0x01,0x68,0x41,0xF4,0x00,0x71,0x01,0x60,0x01,0x68,0x41,0xF4,0x80,0x61,0x01,0x60,
													0x01,0x68,0x41,0xF4,0x80,0x71,0x01,0x60,0x03,0x20,0x00,0xF0,0x61,0xF8,0x00,0x20,
													0x00,0xF0,0x06,0xF8,0x00,0xF0,0x24,0xF8,0x00,0x20,0x10,0xBD,0x00,0x3C,0x02,0x40,
													0x70,0xB5,0x0D,0x4D,0x04,0x46,0x4F,0xF4,0x7A,0x71,0x28,0x78,0xB1,0xFB,0xF0,0xF0,
													0x0A,0x49,0x09,0x68,0xB1,0xFB,0xF0,0xF0,0x00,0xF0,0x0C,0xFB,0x48,0xB9,0x10,0x2C,
													0x07,0xD2,0x00,0x22,0x21,0x46,0x50,0x1E,0x00,0xF0,0x22,0xF8,0x00,0x20,0x6C,0x60,
													0x70,0xBD,0x01,0x20,0x70,0xBD,0x00,0x00,0x10,0x00,0x00,0x20,0x1C,0x00,0x00,0x20,
													0x0A,0x48,0x08,0xB5,0x01,0x68,0x41,0xF4,0x80,0x41,0x01,0x60,0x00,0x68,0x00,0xF4,
													0x80,0x40,0x00,0x90,0x05,0x48,0x00,0x1F,0x01,0x68,0x41,0xF0,0x80,0x51,0x01,0x60,
													0x00,0x68,0x00,0xF0,0x80,0x50,0x00,0x90,0x08,0xBD,0x00,0x00,0x44,0x38,0x02,0x40,
													0xF0,0xB4,0x0E,0x4B,0x1B,0x68,0x0C,0x46,0xC3,0xF3,0x02,0x23,0xC3,0xF1,0x07,0x05,
													0x04,0x2D,0x00,0xD9,0x04,0x25,0x19,0x1D,0x07,0x29,0x01,0xD2,0x00,0x23,0x00,0xE0,
													0xDB,0x1E,0x01,0x26,0x06,0xFA,0x05,0xF1,0x49,0x1E,0x21,0x40,0x99,0x40,0x9E,0x40,
													0x76,0x1E,0x16,0x40,0x31,0x43,0xF0,0xBC,0x00,0xF0,0x99,0xBB,0x0C,0xED,0x00,0xE0,
													0x06,0x49,0x00,0xF0,0x07,0x02,0x08,0x68,0x4F,0xF6,0xFF,0x03,0x18,0x40,0x40,0xEA,
													0x02,0x20,0x03,0x4A,0x10,0x43,0x08,0x60,0x70,0x47,0x00,0x00,0x0C,0xED,0x00,0xE0,
													0x00,0x00,0xFA,0x05,0x2D,0xE9,0xF8,0x43,0x17,0x48,0x01,0x68,0x41,0xF0,0x80,0x51,
													0x01,0x60,0x00,0x68,0x15,0x4F,0x00,0xF0,0x80,0x50,0x01,0x26,0x00,0x90,0x3E,0x64,
													0xFF,0xF7,0x5E,0xFF,0x05,0x46,0x4F,0xF4,0x7A,0x78,0x11,0x4C,0x05,0xE0,0x00,0xBF,
													0xFF,0xF7,0x56,0xFF,0x40,0x1B,0x40,0x45,0x0D,0xD8,0x60,0x68,0xC0,0x03,0xF7,0xD5,
													0x7E,0x64,0xFF,0xF7,0x4D,0xFF,0x05,0x46,0x46,0x46,0x07,0xE0,0xFF,0xF7,0x48,0xFF,
													0x40,0x1B,0xB0,0x42,0x02,0xD9,0x03,0x20,0xBD,0xE8,0xF8,0x83,0x60,0x68,0x80,0x03,
													0xF4,0xD5,0x00,0x20,0xF8,0xE7,0x00,0x00,0x40,0x38,0x02,0x40,0x00,0x00,0x0E,0x42,
													0x00,0x70,0x00,0x40,0x2D,0xE9,0xF0,0x47,0x0E,0x46,0x05,0x00,0x65,0xD0,0xDF,0xF8,
													0x14,0x81,0xD8,0xF8,0x00,0x00,0xF7,0xB2,0x00,0xF0,0x0F,0x00,0xB0,0x42,0x07,0xD2,
													0x88,0xF8,0x00,0x70,0xD8,0xF8,0x00,0x00,0x00,0xF0,0x0F,0x00,0xB0,0x42,0x54,0xD1,
													0x28,0x68,0x3D,0x4C,0x81,0x07,0x12,0xD5,0x40,0x07,0x03,0xD5,0x20,0x68,0x40,0xF4,
													0xE0,0x50,0x20,0x60,0x28,0x78,0x00,0x07,0x03,0xD5,0x20,0x68,0x40,0xF4,0x60,0x40,
													0x20,0x60,0x20,0x68,0xA9,0x68,0x20,0xF0,0xF0,0x00,0x08,0x43,0x20,0x60,0x28,0x78,
													0xC0,0x07,0x2D,0xD0,0x30,0x49,0x68,0x68,0x08,0x39,0x01,0x28,0x12,0xD0,0x02,0x28,
													0x13,0xD0,0x03,0x28,0x11,0xD0,0x09,0x68,0x89,0x07,0x00,0x29,0x2D,0xDA,0x21,0x68,
													0x21,0xF0,0x03,0x01,0x01,0x43,0x21,0x60,0xFF,0xF7,0xF2,0xFE,0x81,0x46,0x41,0xF2,
													0x88,0x3A,0x0E,0xE0,0x09,0x68,0x89,0x03,0xEF,0xE7,0x09,0x68,0x89,0x01,0xEC,0xE7,
													0xFF,0xF7,0xE6,0xFE,0xA0,0xEB,0x09,0x01,0x51,0x45,0x02,0xD9,0x03,0x20,0xBD,0xE8,
													0xF0,0x87,0x20,0x68,0x69,0x68,0x00,0xF0,0x0C,0x00,0xB0,0xEB,0x81,0x0F,0xEF,0xD1,
													0xD8,0xF8,0x00,0x10,0x40,0x46,0x01,0xF0,0x0F,0x01,0xB1,0x42,0x07,0xD9,0x07,0x70,
													0x00,0x68,0x00,0xF0,0x0F,0x00,0xB0,0x42,0x01,0xD0,0x01,0x20,0xE7,0xE7,0x28,0x78,
													0x40,0x07,0x05,0xD5,0x20,0x68,0xE9,0x68,0x20,0xF4,0xE0,0x50,0x08,0x43,0x20,0x60,
													0x28,0x78,0x00,0x07,0x06,0xD5,0x20,0x68,0x29,0x69,0x20,0xF4,0x60,0x40,0x40,0xEA,
													0xC1,0x00,0x20,0x60,0x00,0xF0,0x18,0xF8,0x21,0x68,0x08,0x4A,0xC1,0xF3,0x03,0x11,
													0x51,0x5C,0xC8,0x40,0x06,0x49,0x08,0x60,0x06,0x48,0x00,0x68,0xFF,0xF7,0xD0,0xFE,
													0x00,0x20,0xC4,0xE7,0x00,0x3C,0x02,0x40,0x08,0x38,0x02,0x40,0xD8,0x0D,0x00,0x08,
													0x1C,0x00,0x00,0x20,0x14,0x00,0x00,0x20,0x15,0x48,0x10,0xB5,0x00,0x68,0x10,0xF0,
													0x0C,0x02,0x14,0x48,0x13,0xD0,0x41,0x10,0x04,0x2A,0x0F,0xD0,0x08,0x2A,0x0E,0xD1,
													0x0F,0x4C,0x24,0x1F,0x22,0x68,0x23,0x68,0x02,0xF0,0x3F,0x02,0x5B,0x02,0x07,0xD5,
													0x20,0x68,0xC0,0xF3,0x88,0x10,0xA0,0xFB,0x01,0x01,0x06,0xE0,0x08,0x46,0x10,0xBD,
													0x21,0x68,0xC1,0xF3,0x88,0x11,0xA1,0xFB,0x00,0x01,0x00,0x23,0xFF,0xF7,0xCA,0xFC,
													0x21,0x68,0xC1,0xF3,0x01,0x41,0x49,0x1C,0x49,0x00,0xB0,0xFB,0xF1,0xF0,0x10,0xBD,
													0x08,0x38,0x02,0x40,0x00,0x24,0xF4,0x00,0x2D,0xE9,0xF8,0x4F,0x04,0x00,0x6E,0xD0,
													0x20,0x78,0xDF,0xF8,0x3C,0x93,0xC0,0x07,0xA9,0xF1,0x04,0x05,0x4A,0xD0,0x09,0xF1,
													0x04,0x00,0x01,0x68,0xC1,0xF3,0x81,0x01,0x01,0x29,0x08,0xD0,0x00,0x68,0xC0,0xF3,
													0x81,0x00,0x02,0x28,0x0A,0xD1,0xD9,0xF8,0x00,0x00,0x40,0x02,0x06,0xD5,0x28,0x68,
													0x80,0x03,0x37,0xD5,0x60,0x68,0x00,0x28,0xE1,0xD0,0x33,0xE0,0x60,0x68,0xB0,0xF5,
													0x80,0x3F,0x10,0xD0,0xB0,0xF5,0xA0,0x2F,0x28,0x68,0x10,0xD0,0x20,0xF4,0x80,0x30,
													0x28,0x60,0x28,0x68,0x20,0xF4,0x80,0x20,0x28,0x60,0x60,0x68,0xA8,0xB1,0xFF,0xF7,
													0x37,0xFE,0x06,0x46,0x0D,0xE0,0x28,0x68,0x40,0xF4,0x80,0x30,0xF4,0xE7,0x40,0xF4,
													0x80,0x20,0x28,0x60,0xF7,0xE7,0x00,0xBF,0xFF,0xF7,0x2A,0xFE,0x80,0x1B,0x64,0x28,
													0x73,0xD8,0x28,0x68,0x80,0x03,0xF7,0xD5,0x0C,0xE0,0xFF,0xF7,0x21,0xFE,0x06,0x46,
													0x05,0xE0,0x00,0xBF,0xFF,0xF7,0x1C,0xFE,0x80,0x1B,0x64,0x28,0xF0,0xD8,0x28,0x68,
													0x80,0x03,0xF7,0xD4,0x20,0x78,0xDF,0xF8,0x9C,0x82,0x80,0x07,0x4F,0xF0,0x00,0x0A,
													0x3E,0xD5,0xA3,0x48,0x00,0x1D,0x01,0x68,0x11,0xF0,0x0C,0x0F,0x08,0xD0,0x00,0x68,
													0xC0,0xF3,0x81,0x00,0x02,0x28,0x0B,0xD1,0xD9,0xF8,0x00,0x00,0x40,0x02,0x07,0xD4,
													0x28,0x68,0x80,0x07,0x16,0xD5,0xE0,0x68,0x01,0x28,0x00,0xD1,0x12,0xE0,0x2B,0xE1,
													0xE0,0x68,0xB8,0xB1,0x01,0x20,0xC8,0xF8,0x00,0x00,0xFF,0xF7,0xF1,0xFD,0x06,0x46,
													0x05,0xE0,0x00,0xBF,0xFF,0xF7,0xEC,0xFD,0x80,0x1B,0x02,0x28,0xC0,0xD8,0x28,0x68,
													0x80,0x07,0xF7,0xD5,0x28,0x68,0x21,0x69,0x20,0xF0,0xF8,0x00,0x40,0xEA,0xC1,0x00,
													0x28,0x60,0x0D,0xE0,0xC8,0xF8,0x00,0xA0,0xFF,0xF7,0xDA,0xFD,0x06,0x46,0x04,0xE0,
													0xFF,0xF7,0xD6,0xFD,0x80,0x1B,0x02,0x28,0x1F,0xD8,0x28,0x68,0x80,0x07,0xF7,0xD4,
													0x20,0x78,0x00,0x07,0x22,0xD5,0x82,0x4E,0x83,0x48,0x61,0x69,0x70,0x36,0x71,0xB1,
													0x01,0x21,0x01,0x60,0xFF,0xF7,0xC4,0xFD,0x07,0x46,0x04,0xE0,0xFF,0xF7,0xC0,0xFD,
													0xC0,0x1B,0x02,0x28,0x09,0xD8,0x30,0x68,0x80,0x07,0xF7,0xD5,0x0E,0xE0,0xC0,0xF8,
													0x00,0xA0,0xFF,0xF7,0xB5,0xFD,0x07,0x46,0x05,0xE0,0x82,0xE0,0xFF,0xF7,0xB0,0xFD,
													0xC0,0x1B,0x02,0x28,0x7D,0xD8,0x30,0x68,0x80,0x07,0xF7,0xD4,0x20,0x78,0x40,0x07,
													0x68,0xD5,0xDF,0xF8,0xBC,0xB1,0x00,0x27,0x0B,0xF1,0x3C,0x0B,0xDB,0xF8,0x00,0x00,
													0xC0,0x00,0x0B,0xD4,0xDB,0xF8,0x00,0x10,0x41,0xF0,0x80,0x51,0xCB,0xF8,0x00,0x10,
													0xDB,0xF8,0x00,0x00,0x01,0x27,0x00,0xF0,0x80,0x50,0x00,0x90,0x67,0x4E,0x30,0x68,
													0xC0,0x05,0x10,0xD4,0x30,0x68,0x40,0xF4,0x80,0x70,0x30,0x60,0xFF,0xF7,0x88,0xFD,
													0x00,0x90,0x05,0xE0,0xFF,0xF7,0x84,0xFD,0x00,0x99,0x40,0x1A,0x02,0x28,0x50,0xD8,
													0x30,0x68,0xC0,0x05,0xF6,0xD5,0x5A,0x4E,0xA0,0x68,0x6C,0x36,0x01,0x28,0x0F,0xD0,
													0x05,0x28,0x30,0x68,0x10,0xD0,0x20,0xF0,0x01,0x00,0x30,0x60,0x30,0x68,0x20,0xF0,
													0x04,0x00,0x30,0x60,0xA0,0x68,0xB8,0xB1,0xFF,0xF7,0x6A,0xFD,0x00,0x90,0x0F,0xE0,
													0x30,0x68,0x40,0xF0,0x01,0x00,0xF4,0xE7,0x40,0xF0,0x04,0x00,0x30,0x60,0xF7,0xE7,
													0xFF,0xF7,0x5E,0xFD,0x00,0x99,0x41,0x1A,0x41,0xF2,0x88,0x30,0x81,0x42,0x66,0xD8,
													0x30,0x68,0x80,0x07,0xF4,0xD5,0x0E,0xE0,0xFF,0xF7,0x52,0xFD,0x00,0x90,0x07,0xE0,
													0xFF,0xF7,0x4E,0xFD,0x00,0x99,0x41,0x1A,0x41,0xF2,0x88,0x30,0x81,0x42,0x56,0xD8,
													0x30,0x68,0x80,0x07,0xF4,0xD4,0x2F,0xB1,0xDB,0xF8,0x00,0x10,0x21,0xF0,0x80,0x51,
													0xCB,0xF8,0x00,0x10,0xA0,0x69,0xC8,0xB3,0x39,0x49,0x09,0x1D,0x09,0x68,0xC1,0xF3,
													0x81,0x01,0x02,0x29,0x4A,0xD0,0x02,0x28,0x50,0x46,0x07,0xD0,0xC8,0xF8,0x60,0x00,
													0x00,0xE0,0x3C,0xE0,0xFF,0xF7,0x2C,0xFD,0x04,0x46,0x3B,0xE0,0x47,0x46,0xC8,0xF8,
													0x60,0x00,0xFF,0xF7,0x25,0xFD,0x06,0x46,0x05,0xE0,0x00,0xBF,0xFF,0xF7,0x20,0xFD,
													0x80,0x1B,0x02,0x28,0x2B,0xD8,0x28,0x68,0x80,0x01,0xF7,0xD4,0xD4,0xE9,0x07,0x01,
													0x08,0x43,0xA1,0x6A,0x2A,0x4A,0x49,0x08,0x02,0xEB,0x01,0x41,0x62,0x6A,0x41,0xEA,
													0x82,0x11,0x08,0x43,0x94,0xF8,0x2C,0x10,0x40,0xEA,0x01,0x61,0xC9,0xF8,0x00,0x10,
													0x01,0x20,0x38,0x66,0xFF,0xF7,0x04,0xFD,0x04,0x46,0x06,0xE0,0x36,0xE0,0x00,0xBF,
													0xFF,0xF7,0xFE,0xFC,0x00,0x1B,0x02,0x28,0x09,0xD8,0x28,0x68,0x80,0x01,0xF7,0xD5,
													0x2C,0xE0,0x00,0xBF,0xFF,0xF7,0xF4,0xFC,0x00,0x1B,0x02,0x28,0x02,0xD9,0x03,0x20,
													0xBD,0xE8,0xF8,0x8F,0x28,0x68,0x80,0x01,0xF4,0xD4,0x1F,0xE0,0x01,0x28,0xF7,0xD0,
													0xD9,0xF8,0x00,0x00,0xE2,0x69,0x00,0xF4,0x80,0x01,0x91,0x42,0x14,0xD1,0x22,0x6A,
													0x00,0xF0,0x3F,0x01,0x91,0x42,0x0F,0xD1,0x47,0xF6,0xC0,0x71,0x62,0x6A,0x01,0x40,
													0x91,0x42,0x09,0xD1,0xA2,0x6A,0x00,0xF4,0x40,0x31,0x91,0x42,0x04,0xD1,0xE1,0x6A,
													0x00,0xF0,0x70,0x60,0x88,0x42,0x01,0xD0,0x01,0x20,0xD9,0xE7,0x00,0x20,0xD7,0xE7,
													0x04,0x38,0x02,0x40,0x00,0x00,0x47,0x42,0x80,0x0E,0x47,0x42,0x00,0x70,0x00,0x40,
													0x00,0x00,0xFF,0xFF,0x10,0xB5,0x40,0x1E,0xB0,0xF1,0x80,0x7F,0x01,0xD3,0x01,0x20,
													0x10,0xBD,0x4F,0xF0,0xE0,0x24,0x60,0x61,0x0F,0x21,0x60,0x17,0x00,0xF0,0xC7,0xF8,
													0x00,0x20,0xA0,0x61,0x07,0x20,0x20,0x61,0x00,0x20,0x10,0xBD,0xFE,0xE7,0x00,0x00,
													0x09,0x48,0x08,0xB5,0x01,0x68,0x41,0xF0,0x80,0x01,0x01,0x60,0x01,0x68,0x01,0xF0,
													0x80,0x01,0x00,0x91,0x01,0x68,0x41,0xF0,0x01,0x01,0x01,0x60,0x00,0x68,0x00,0xF0,
													0x01,0x00,0x00,0x90,0x08,0xBD,0x00,0x00,0x30,0x38,0x02,0x40,0x01,0x4A,0x10,0x70,
													0x51,0x60,0x70,0x47,0x08,0x00,0x00,0x20,0x2D,0xE9,0xF0,0x41,0x22,0x4D,0x0F,0x46,
													0x98,0x46,0x69,0x68,0x16,0x46,0x0C,0x18,0xFF,0xF7,0x6C,0xFC,0x02,0x21,0x28,0x78,
													0xFF,0xF7,0x46,0xFB,0xFF,0xF7,0x1E,0xFC,0xFF,0xF7,0x64,0xFC,0x5F,0xEA,0x08,0x00,
													0x05,0xD0,0x01,0x28,0x10,0xD0,0xB8,0xF1,0x02,0x0F,0x28,0xD1,0x1A,0xE0,0x00,0x25,
													0x07,0xE0,0x00,0x23,0x7A,0x5D,0x21,0x46,0x18,0x46,0xFF,0xF7,0x15,0xFC,0x64,0x1C,
													0x6D,0x1C,0xB5,0x42,0xF5,0xD3,0x1A,0xE0,0x00,0x25,0x08,0xE0,0x37,0xF8,0x15,0x20,
													0x00,0x23,0x21,0x46,0x01,0x20,0xFF,0xF7,0x07,0xFC,0xA4,0x1C,0x6D,0x1C,0xB5,0x42,
													0xF4,0xD3,0x0C,0xE0,0x00,0x25,0x08,0xE0,0x57,0xF8,0x25,0x20,0x00,0x23,0x21,0x46,
													0x02,0x20,0xFF,0xF7,0xF9,0xFB,0x24,0x1D,0x6D,0x1C,0xB5,0x42,0xF4,0xD3,0xBD,0xE8,
													0xF0,0x41,0xFF,0xF7,0xE7,0xBB,0x00,0x00,0x08,0x00,0x00,0x20,0xFE,0xE7,0x70,0x47,
													0x70,0x47,0x70,0x47,0xFF,0xF7,0x42,0xBC,0x30,0xB5,0x93,0xB0,0x30,0x21,0x68,0x46,
													0xFF,0xF7,0xC0,0xFA,0x14,0x21,0x0C,0xA8,0xFF,0xF7,0xBC,0xFA,0x1A,0x48,0x00,0x25,
													0x01,0x68,0x41,0xF0,0x80,0x51,0x01,0x60,0x00,0x68,0x00,0xF0,0x80,0x50,0x11,0x90,
													0x16,0x48,0x01,0x68,0x41,0xF4,0x40,0x41,0x01,0x60,0x00,0x68,0x02,0x24,0x00,0xF4,
													0x40,0x40,0x11,0x90,0x01,0x20,0x00,0x90,0x00,0x04,0x01,0x90,0x80,0x01,0xCD,0xE9,
													0x06,0x40,0x08,0xAA,0x04,0x20,0xB4,0x21,0x82,0xE8,0x13,0x00,0x0B,0x90,0x68,0x46,
													0xFF,0xF7,0xA2,0xFD,0xFF,0xF7,0x9E,0xFC,0x0C,0xA9,0x0F,0x20,0x81,0xE8,0x31,0x00,
													0x4F,0xF4,0xA0,0x50,0x0F,0x90,0xE0,0x02,0x10,0x90,0x05,0x21,0x0C,0xA8,0xFF,0xF7,
													0xC9,0xFC,0x13,0xB0,0x30,0xBD,0x00,0x00,0x40,0x38,0x02,0x40,0x00,0x70,0x00,0x40,
													0x05,0x48,0x01,0x68,0x41,0xF4,0x70,0x01,0x01,0x60,0x03,0x49,0x4F,0xF0,0x00,0x60,
													0x80,0x39,0x08,0x60,0x70,0x47,0x00,0x00,0x88,0xED,0x00,0xE0,0xFE,0xE7,0x09,0x07,
													0x09,0x0E,0x00,0x28,0x04,0xDB,0x00,0xF1,0xE0,0x20,0x80,0xF8,0x00,0x14,0x70,0x47,
													0x00,0xF0,0x0F,0x00,0x00,0xF1,0xE0,0x20,0x80,0xF8,0x14,0x1D,0x70,0x47,0x02,0xE0,
													0x08,0xC8,0x12,0x1F,0x08,0xC1,0x00,0x2A,0xFA,0xD1,0x70,0x47,0x70,0x47,0x00,0x20,
													0x01,0xE0,0x01,0xC1,0x12,0x1F,0x00,0x2A,0xFB,0xD1,0x70,0x47,0xFF,0xF7,0xD6,0xFB,
													0xFF,0xF7,0x8A,0xFF,0xFF,0xF7,0x1C,0xFF,0x05,0x49,0x0B,0x20,0xFF,0xF7,0x2E,0xFF,
													0x00,0x23,0x05,0x22,0x03,0x49,0x18,0x46,0xFF,0xF7,0x2E,0xFF,0xFE,0xE7,0x00,0x00,
													0x00,0x00,0x0E,0x08,0x00,0x00,0x00,0x20,0x00,0x00,0x00,0x00,0x00,0x00,0x00,0x00,
													0x01,0x02,0x03,0x04,0x06,0x07,0x08,0x09,0x08,0x0E,0x00,0x08,0x00,0x00,0x00,0x20,
													0x20,0x00,0x00,0x00,0x8E,0x0D,0x00,0x08,0x28,0x0E,0x00,0x08,0x20,0x00,0x00,0x20,
													0x20,0x04,0x00,0x00,0x9E,0x0D,0x00,0x08,0x11,0x22,0x33,0x44,0x55,0x00,0x00,0x00,
													0x00,0x00,0x00,0x00,0x00,0x00,0x00,0x00,0x01,0x00,0x00,0x00,0x10,0x00,0x00,0x00,
													0x00,0x00,0x00,0x00,0x00,0x24,0xF4,0x00};

/* USER CODE END PV */

void SystemClock_Config(void);

int main(void)
{

  /* MCU Configuration--------------------------------------------------------*/

  /* Reset of all peripherals, Initializes the Flash interface and the Systick. */
  HAL_Init();

  /* Configure the system clock */
  SystemClock_Config();

  /* Initialize all configured peripherals */
  MX_GPIO_Init();
  /* USER CODE BEGIN 2 */
	MY_FLASH_SetSectorAddrs(11, 0x080E0000);
	MY_FLASH_WriteN(0, hex_code, 3624, DATA_TYPE_8);
  /* USER CODE END 2 */

  /* Infinite loop */
  while (1)
  {

  }
}

void SystemClock_Config(void)
{
  RCC_OscInitTypeDef RCC_OscInitStruct = {0};
  RCC_ClkInitTypeDef RCC_ClkInitStruct = {0};

  /** Configure the main internal regulator output voltage
  */
  __HAL_RCC_PWR_CLK_ENABLE();
  __HAL_PWR_VOLTAGESCALING_CONFIG(PWR_REGULATOR_VOLTAGE_SCALE1);
  /** Initializes the CPU, AHB and APB busses clocks
  */
  RCC_OscInitStruct.OscillatorType = RCC_OSCILLATORTYPE_HSE;
  RCC_OscInitStruct.HSEState = RCC_HSE_ON;
  RCC_OscInitStruct.PLL.PLLState = RCC_PLL_ON;
  RCC_OscInitStruct.PLL.PLLSource = RCC_PLLSOURCE_HSE;
  RCC_OscInitStruct.PLL.PLLM = 4;
  RCC_OscInitStruct.PLL.PLLN = 180;
  RCC_OscInitStruct.PLL.PLLP = RCC_PLLP_DIV2;
  RCC_OscInitStruct.PLL.PLLQ = 4;
  if (HAL_RCC_OscConfig(&RCC_OscInitStruct) != HAL_OK)
  {
    Error_Handler();
  }
  /** Activate the Over-Drive mode
  */
  if (HAL_PWREx_EnableOverDrive() != HAL_OK)
  {
    Error_Handler();
  }
  /** Initializes the CPU, AHB and APB busses clocks
  */
  RCC_ClkInitStruct.ClockType = RCC_CLOCKTYPE_HCLK|RCC_CLOCKTYPE_SYSCLK
                              |RCC_CLOCKTYPE_PCLK1|RCC_CLOCKTYPE_PCLK2;
  RCC_ClkInitStruct.SYSCLKSource = RCC_SYSCLKSOURCE_PLLCLK;
  RCC_ClkInitStruct.AHBCLKDivider = RCC_SYSCLK_DIV1;
  RCC_ClkInitStruct.APB1CLKDivider = RCC_HCLK_DIV4;
  RCC_ClkInitStruct.APB2CLKDivider = RCC_HCLK_DIV2;

  if (HAL_RCC_ClockConfig(&RCC_ClkInitStruct, FLASH_LATENCY_5) != HAL_OK)
  {
    Error_Handler();
  }
}

void Error_Handler(void)
{
}

/************************ (C) COPYRIGHT STMicroelectronics *****END OF FILE****/
